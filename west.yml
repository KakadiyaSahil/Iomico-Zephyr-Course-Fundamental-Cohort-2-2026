## west.yml
```yaml
manifest:
  version: 1.0
  self: 
    path: Iomico-Zephyr-Course
  projects:
    - name: zephyr
      url: https://github.com/zephyrproject-rtos/zephyr
      revision: v4.2.0
      import:
        name-allowlist:
          - cmsis_6
          - hal_espressif
        path-prefix: deps
```
